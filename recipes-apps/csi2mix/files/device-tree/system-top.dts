/*
 * CAUTION: This file is automatically generated by Xilinx.
 * Version: XSCT 2025.1
 * Today is: Sun Aug 30 09:31:53 2026
 */


/dts-v1/;
#include "zynqmp.dtsi"
#include "zynqmp-u-boot.dtsi"
#include "zynqmp-clk-ccf.dtsi"
#include "pcw.dtsi"
/ {
	chosen {
		bootargs = "earlycon";
		stdout-path = "serial0:115200n8";
	};
	aliases {
		ethernet0 = &gem3;
		i2c0 = &i2c1;
		serial0 = &uart1;
		serial1 = &dcc;
		spi0 = &qspi;
		spi1 = &spi1;
	};
	memory@0 {
		device_type = "memory";
		reg = <0x0 0x0 0x0 0x7ff00000>, <0x00000008 0x00000000 0x0 0x80000000>;
	};
};
